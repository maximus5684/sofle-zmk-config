## config/west.yml
```yaml
manifest:
  remotes:
    - name: zmkfirmware
      url-base: https://github.com/maximus5684
  projects:
    - name: zmk
      remote: zmkfirmware
      revision: sofle_rgb_keyhive_dual_encoders
      import: app/west.yml
  self:
    path: config
```
